## configs/genesys2_defconfig
```kconfig
#
# CPU / Architecture
#
CONFIG_RISCV=y
CONFIG_ARCH_RV64I=y
CONFIG_CPU=y
CONFIG_CPU_RISCV=y
CONFIG_RISCV_SMODE=y

#
# Basic Configuration
#
CONFIG_DM=y
CONFIG_SYS_MALLOC_LEN=0x800000
CONFIG_SYS_MALLOC_F_LEN=0x4000

#
# Board Configuration
#
CONFIG_TARGET_GENESYS2=y
CONFIG_SYS_CONFIG_NAME="genesys2"
CONFIG_OF_EMBED=y
CONFIG_DEFAULT_DEVICE_TREE="OneRocketCoreWithOneISBFanOffConfig"


#
# DDR / U-Boot Address Layout
# OpenSBI occupies 0x80000000–0x8003FFFF
#
CONFIG_TEXT_BASE=0x80200000
CONFIG_SYS_UBOOT_START=0x80200000
# CONFIG_SYS_LOAD_ADDR=0x80200000
CONFIG_SYS_LOAD_ADDR=0x80400000
# Stack
CONFIG_HAS_CUSTOM_SYS_INIT_SP_ADDR=y
CONFIG_CUSTOM_SYS_INIT_SP_ADDR=0x8009FE00

#
# UART Console
#
CONFIG_SERIAL=y
CONFIG_DM_SERIAL=y
CONFIG_SIFIVE_SERIAL=y
CONFIG_BAUDRATE=115200

# Debug UART
CONFIG_DEBUG_UART=y
CONFIG_DEBUG_UART_BASE=0x64000000
CONFIG_DEBUG_UART_CLOCK=50000000
CONFIG_DEBUG_UART_SHIFT=0
CONFIG_DEBUG_UART_ANNOUNCE=y

#
# MMC/SD over SPI
#
CONFIG_SPI=y
CONFIG_DM_SPI=y
CONFIG_SPI_SIFIVE=y
CONFIG_MMC=y
CONFIG_MMC_WRITE=y
CONFIG_MMC_SPI=y
CONFIG_MMC_BROKEN_CD=y
CONFIG_DM_MMC=y
CONFIG_CMD_MMC=y

#
# File Systems
#
CONFIG_FS_FAT=y
CONFIG_CMD_EXT2=y
CONFIG_FAT_WRITE=y
CONFIG_FS_EXT4=y
CONFIG_EXT4_WRITE=y
CONFIG_CMD_FS_GENERIC=y
CONFIG_CMD_FAT=y
CONFIG_CMD_EXT4=y
CONFIG_EFI_PARTITION=y
CONFIG_CMD_GPT=y

# fatload mmc 0:1 0x80480000 Image;
#
# Boot Command
#
CONFIG_USE_BOOTCOMMAND=y
CONFIG_BOOTCOMMAND="mmc dev 0; \
  fatload mmc 0:1 0x80400000 Image; \
  fatload mmc 0:1 0x88000000 system.dtb; \
  booti 0x80400000 - 0x88000000"

CONFIG_AUTOBOOT=y
CONFIG_BOOTDELAY=2
CONFIG_USE_BOOTARGS=y
CONFIG_BOOTARGS="root=/dev/mmcblk0p2 rootwait rw console=ttySIF0,115200 earlycon init=/sbin/init ext4.lazy_itable_init=0 ext4.lazy_journal_init=0"
#CONFIG_BOOTARGS="root=/dev/mmcblk0p2 rw console=ttySIF0,115200 earlycon init=/sbin/init"

#
# Timer / IRQ
#
CONFIG_TIMER=y
CONFIG_RISCV_TIMER=y
CONFIG_IRQ=y
CONFIG_CMODEL_MEDANY=y
# CONFIG_TIMER_EARLY is not set

#
# Debug / Test Tools
#
CONFIG_LOG=y
CONFIG_LOG_DEFAULT_LEVEL=7
CONFIG_LOGLEVEL=7
CONFIG_LOG_ERROR_RETURN=y
CONFIG_LOG_CONSOLE=y
CONFIG_DM_DEBUG=y
CONFIG_DM_WARN=y
CONFIG_CMD_DM=y
CONFIG_CMD_LOG=y
CONFIG_DM_DEVICE_REMOVE=y
CONFIG_DM_STATS=y
CONFIG_MISC=y
CONFIG_CMD_MEMTEST=y

#
# Cache / Memory
#
CONFIG_CACHE=y
CONFIG_SIFIVE_CCACHE=y
CONFIG_MEMORY=y
```
